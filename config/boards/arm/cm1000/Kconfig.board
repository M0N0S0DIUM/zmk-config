## config/boards/arm/cm1000/Kconfig.board
```kconfig
# SPDX-License-Identifier: MIT

if BOARD_CM1000 || BOARD_CM1000_NRF52840_ZMK

config BOARD_CM1000_INIT
    bool "CM1000 board init (ISET charge current)"
    default y
    help
      Drives BQ24075 ISET GPIO pins at boot to configure the default
      charge current (~350 mA).

endif
```

## config/boards/arm/cm1000/Kconfig.cm1000
```kconfig
config BOARD_CM1000
    select SOC_NRF52840_QIAA if BOARD_CM1000_NRF52840
    select SOC_NRF52840_QIAA if BOARD_CM1000_NRF52840_ZMK
    imply RETAINED_MEM
    imply RETENTION
    imply RETENTION_BOOT_MODE

config ZMK_BOARD_COMPAT
    default y if BOARD_CM1000 || BOARD_CM1000_NRF52840_ZMK
```

## config/boards/arm/cm1000/Kconfig.defconfig
```kconfig
if BOARD_CM1000

config BOARD
    default "cm1000"

config ZMK_KEYBOARD_NAME
    default "CM1000"

config ZMK_RGB_UNDERGLOW
    default y

config ZMK_DISPLAY
    default y

config ZMK_STUDIO
    default y

config ZMK_BATTERY
    default y

config USB_NRFX
    default y
    depends on USB_DEVICE_STACK

config BT_CTLR
    default y

endif # BOARD_CM1000
```

## config/boards/arm/cm1000/cm1000_defconfig
```kconfig
CONFIG_GPIO=y
CONFIG_I2C=y
CONFIG_SPI=y
CONFIG_USB_DEVICE_STACK=y
CONFIG_BT=y
CONFIG_BT_MAX_PAIRED=5
CONFIG_BUILD_OUTPUT_UF2=y
CONFIG_ZMK_USB=y
CONFIG_ZMK_BLE=y
CONFIG_SETTINGS=y
CONFIG_ARM_MPU=y
CONFIG_PINCTRL=y
CONFIG_USE_DT_CODE_PARTITION=y
CONFIG_MPU_ALLOW_FLASH_WRITE=y
CONFIG_NVS=y
CONFIG_SETTINGS_NVS=y
CONFIG_FLASH_PAGE_LAYOUT=y
CONFIG_FLASH_MAP=y
```

## config/west.yml
```yaml
manifest:
  defaults:
    revision: main
  remotes:
    - name: zmkfirmware
      url-base: https://github.com/zmkfirmware
    - name: mctechnology17
      url: https://github.com/mctechnology17
  projects:
    - name: zmk
      remote: zmkfirmware
      import: app/west.yml
    - name: zmk-nice-oled
      remote: mctechnology17
      revision: main
      path: modules/zmk-nice-oled
  self:
    path: config
```
